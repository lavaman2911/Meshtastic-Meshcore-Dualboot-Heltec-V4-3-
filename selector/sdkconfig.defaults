## selector/sdkconfig.defaults
```kconfig
CONFIG_IDF_TARGET="esp32s3"

# Flash / partition basics
CONFIG_ESPTOOLPY_FLASHSIZE_8MB=y
CONFIG_ESPTOOLPY_FLASHMODE_DIO=y
CONFIG_ESPTOOLPY_FLASHFREQ_80M=y

# Boot / app
CONFIG_APP_BUILD_TYPE_APP_2NDBOOT=y

# Logging (optional but stable)
CONFIG_LOG_DEFAULT_LEVEL_INFO=y

# Partition sanity
CONFIG_PARTITION_TABLE_SINGLE_APP=n
CONFIG_PARTITION_TABLE_CUSTOM=y

# Safety defaults
CONFIG_COMPILER_OPTIMIZATION_SIZE=y
CONFIG_COMPILER_WARN_WRITE_STRINGS=y
```
